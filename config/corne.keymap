/*
 * Copyright (c) 2020 The ZMK Contributors
 *
 * SPDX-License-Identifier: MIT
 */

/* source key position labels */
#include "zmk-helpers/key-labels/42.h"

/* map the Corne's extra keys */
#define X_LT    &none
#define X_RT    &none

#define X_LM    &none
#define X_RM    &none

#define X_LB    &none
#define X_RB    &none

#define X_LH  &kp LGUI      // thumb row, left
#define X_RH  &smart_mouse  // thumb row, right

/* activate bluetooth */
#define CONFIG_WIRELESS 1

/* source the main keymap */
#include "base.keymap"

